## conf/machine/include/rpi-default-versions.inc
```bitbake
# RaspberryPi BSP default versions

#PREFERRED_VERSION_linux-raspberrypi ?= "3.18.%"
PREFERRED_VERSION_linux-raspberrypi ?= "3.12.36-rt%"
```
